## conf/layer.conf
```bitbake
# We have a conf and classes directory, add to BBPATH
BBPATH .= ":${LAYERDIR}"

# We have recipes-* directories, add to BBFILES
BBFILES += "${LAYERDIR}/recipes-*/*/*.bb \\
            ${LAYERDIR}/recipes-*/*/*.bbappend"

BBFILE_COLLECTIONS += "magonis-layer"
BBFILE_PATTERN_magonis-layer = "^${LAYERDIR}/"
BBFILE_PRIORITY_magonis-layer = "6"

LAYERDEPENDS_magonis-layer = "core"
LAYERSERIES_COMPAT_magonis-layer = "kirkstone dunfell" # Specify compatible Yocto releases

# Optional: Add license info if distributing the layer itself under specific terms
# LICENSE_PATH += "${LAYERDIR}/licenses"
```
